/*
 * grondMap.c
 *
 *  Created on: Mar 28, 2024
 *      Author: frenk
 */


#include "grondMap.h"


//basic map if no random map generation
uint8_t tileMap[TILEHEIGHT][TILEWIDTH] =
  {
		  {0,0,0,0,0,0,0,0,0,0 ,0,0,0,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0,0 },
		  {0,0,0,0,0,0,0,0,0,0 ,0,0,0,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0,0 },
		  {0,0,0,0,0,0,0,0,0,0 ,0,0,0,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0,0 },
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		  {1,1,1,1,1,1,1,1,1,1 ,1,1,1,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1,1}




  };
/**
  * @brief Generates new random map
  * @param none
  * @returns none
  * 
  * 
  */
void genereateRandomMap(){
	HAL_ADC_Start(&hadc);
	HAL_ADC_PollForConversion(&hadc, HAL_MAX_DELAY);
	int seed = HAL_ADC_GetValue(&hadc);
	srand(seed);
	uint8_t x_teller = 0;
	uint8_t y_teller = 0;
	for(y_teller = 12; y_teller < TILEHEIGHT; y_teller++){
		for(x_teller = 0; x_teller < TILEWIDTH; x_teller++){
			tileMap[y_teller][x_teller] = 1;
		}
	}


    for(int i = 0; i < TILEWIDTH; i+=4) {
        for(int b = 13 ; b > 1 ; b--) {
            if(tileMap[b + 1][i] == 0) {
				tileMap[b][i] = 0;
                for(int j = 0; j < 4; j++) {
					tileMap[b][i + j] = tileMap[b][i];
				}
            } else {
                tileMap[b][i] = rand() %2;
				for(int j = 0; j < 4; j++) {
					tileMap[b][i + j] = tileMap[b][i];
				}
            }
		}
	}
}

/**
  * @brief Show the map on screen
  * @param none
  * @returns none
  * 
  * 
  */
void mapDataStart(){

	uint16_t totale_data;

	uint8_t x_teller = 0;
	uint8_t y_teller = 0;

	for(y_teller = 0; y_teller < TILEHEIGHT; y_teller++){
		for(x_teller = 0; x_teller < TILEWIDTH; x_teller++){
			totale_data = (x_teller << 9 | y_teller << 4);
			if(tileMap[y_teller][x_teller] == 0){
				sendData(GROUND_OFF,totale_data);
			} else if(tileMap[y_teller][x_teller] == 1) {
				sendData(GROUND_ON,totale_data);
			}
		}
	}
}
/**
  * @brief Turns off the map onscreen
  * @param none
  * @returns none
  * 
  * 
  */
void mapDataOff(){

	uint16_t totale_data;

	uint8_t x_teller = 0;
	uint8_t y_teller = 0;

	for(y_teller = 0; y_teller < TILEHEIGHT; y_teller++){
		for(x_teller = 0; x_teller < TILEWIDTH; x_teller++){
			totale_data = (x_teller << 9 | y_teller << 4);
				sendData(GROUND_OFF,totale_data);
		}
	}
}
/**
  * @brief Updates map on certain coordinates
  * @param int x coordinate
  * @param int y coordinate
  * @returns none
  * 
  * 
  */
void mapDataUpdate(int x_data, int y_data){
	uint16_t totale_data = (x_data << 9 | y_data << 4);
	if(tileMap[y_data][x_data] == 0){
		sendData(GROUND_OFF,totale_data);
	} else if(tileMap[y_data][x_data] == 1) {
		sendData(GROUND_ON,totale_data);
	}
}

